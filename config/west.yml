## config/west.yml
```yaml
manifest:
  remotes:
    - name: zmk
      url-base: https://github.com/JoMa388
    # Additional modules containing boards/shields/custom code can be listed here as well
    # See https://docs.zephyrproject.org/3.2.0/develop/west/manifest.html#projects
  projects:
    - name: zmk
      remote: JoMa388
      revision: feat/pointers-mouse-move-scroll
      import: app/west.yml
  self:
    path: config
```
